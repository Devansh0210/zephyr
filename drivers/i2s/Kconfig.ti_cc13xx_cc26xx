## drivers/i2s/Kconfig.ti_cc13xx_cc26xx
```kconfig
menuconfig I2S_CC13XX_CC26XX
	bool "CC13XX_CC26XX MCU I2S controller driver"
	default y
	depends on DT_HAS_TI_CC13XX_CC26XX_I2S_ENABLED
	select PINCTRL

if I2S_CC13XX_CC26XX

config I2S_CC13XX_CC26XX_RX_BLOCK_COUNT
	int "RX queue length"
	default 4

config I2S_CC13XX_CC26XX_TX_BLOCK_COUNT
	int "TX queue length"
	default 4

endif # I2S_CC13XX_CC26XX
```

## dts/bindings/i2s/ti,cc13xx-cc26xx-i2s.yaml
```yaml
description: TI-CC13XX I2S

compatible: "ti,cc13xx-cc26xx-i2s"

include: [i2s-controller.yaml, pinctrl-device.yaml, base.yaml]

properties:
  reg:
    required: true

  interrupts:
    required: true

  pinctrl-0:
    required: true

  pinctrl-names:
    required: true

  mck-enabled:
    type: boolean
    description: |
      Master Clock Output function.
      An mck pin must be listed within pinctrl-0 when enabling this property.
```
